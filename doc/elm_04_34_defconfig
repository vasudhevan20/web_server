## doc/elm_04_34_defconfig
```kconfig
BR2_aarch64=y
BR2_cortex_a35=y
BR2_ARM_FPU_VFPV4=y
BR2_JLEVEL=12
BR2_TOOLCHAIN_EXTERNAL=y
BR2_PACKAGE_HOST_GDB=y
BR2_ECLIPSE_REGISTER=y
BR2_TARGET_GENERIC_HOSTNAME="elmeasure"
BR2_TARGET_GENERIC_ISSUE="Welcome to elmeasure"
BR2_TARGET_GENERIC_PASSWD_SHA256=y
BR2_INIT_SYSTEMD=y
BR2_TARGET_GENERIC_ROOT_PASSWD="root"
BR2_SYSTEM_BIN_SH_BASH=y
BR2_ROOTFS_OVERLAY="board/rockchip/rk3308/fs-overlay"
BR2_LINUX_KERNEL=y
BR2_LINUX_KERNEL_DEFCONFIG="rk3308_linux"
BR2_LINUX_KERNEL_INSTALL_TARGET=y
BR2_LINUX_KERNEL_CUSTOM_GIT=y
BR2_LINUX_KERNEL_CUSTOM_REPO_URL=" https://github.com/radxa/kernel.git"
BR2_LINUX_KERNEL_CUSTOM_REPO_VERSION="9c2fa74e977925bc4adaa5c14156cd49e25d4878"
BR2_PACKAGE_BUSYBOX_CONFIG="board/rockchip/rk3308/busybox.config"
BR2_PACKAGE_STRACE=y
BR2_PACKAGE_E2FSPROGS=y
BR2_PACKAGE_E2FSPROGS_RESIZE2FS=y
BR2_PACKAGE_EXFAT=y
BR2_PACKAGE_MMC_UTILS=y
BR2_PACKAGE_NTFS_3G=y
BR2_PACKAGE_NTFS_3G_NTFSPROGS=y
BR2_PACKAGE_DBUS_TRIGGERD=y
BR2_PACKAGE_IOSTAT=y
BR2_PACKAGE_USBMOUNT=y
BR2_PACKAGE_JSON_C=y
BR2_PACKAGE_LIBCURL=y
BR2_PACKAGE_CURL=y
BR2_PACKAGE_LIBMICROHTTPD_SSL=y
BR2_PACKAGE_PAHO_MQTT_C=y
BR2_PACKAGE_LIBEVENT=y
BR2_PACKAGE_CONNMAN=y
BR2_PACKAGE_CONNMAN_WIFI=y
BR2_PACKAGE_CONNMAN_WISPR=y
BR2_PACKAGE_CONNMAN_BLUETOOTH=y
BR2_PACKAGE_CONNMAN_DEBUG=y
BR2_PACKAGE_CONNMAN_CLIENT=y
BR2_PACKAGE_DNSMASQ=y
# BR2_PACKAGE_DNSMASQ_TFTP is not set
BR2_PACKAGE_IW=y
BR2_PACKAGE_NETWORK_MANAGER=y
BR2_PACKAGE_NETWORK_MANAGER_TUI=y
BR2_PACKAGE_NETWORK_MANAGER_MODEM_MANAGER=y
BR2_PACKAGE_NETWORK_MANAGER_PPPD=y
BR2_PACKAGE_NETWORK_MANAGER_OVS=y
BR2_PACKAGE_OPENSSH=y
# BR2_PACKAGE_PPPD_OVERWRITE_RESOLV_CONF is not set
BR2_PACKAGE_WPA_SUPPLICANT_AUTOSCAN=y
BR2_PACKAGE_WPA_SUPPLICANT_CLI=y
BR2_PACKAGE_WPA_SUPPLICANT_WPA_CLIENT_SO=y
BR2_PACKAGE_WPA_SUPPLICANT_DBUS_INTROSPECTION=y
BR2_PACKAGE_HTOP=y
BR2_PACKAGE_PROCRANK_LINUX=y
BR2_PACKAGE_SYSTEMD_JOURNAL_GATEWAY=y
BR2_TARGET_ROOTFS_EXT2=y
BR2_TARGET_ROOTFS_EXT2_4=y
BR2_TARGET_ROOTFS_EXT2_SIZE="400M"
BR2_TARGET_ROOTFS_SQUASHFS=y
# BR2_TARGET_ROOTFS_TAR is not set
BR2_TARGET_UBOOT=y
BR2_TARGET_UBOOT_BUILD_SYSTEM_KCONFIG=y
BR2_TARGET_UBOOT_CUSTOM_GIT=y
BR2_TARGET_UBOOT_CUSTOM_REPO_URL="https://github.com/radxa/u-boot.git"
BR2_TARGET_UBOOT_CUSTOM_REPO_VERSION="c3d3bc84bef5ee95d7199c23e1a34e47ea8f0daf"
BR2_TARGET_UBOOT_BOARD_DEFCONFIG="rockpi-s-rk3308"
BR2_TARGET_UBOOT_FORMAT_IMG=y
BR2_PACKAGE_HOST_MKE2IMG=y
BR2_PACKAGE_HOST_NTFS_3G=y
BR2_PACKAGE_HOST_QEMU=y
BR2_PACKAGE_HOST_VBOOT_UTILS=y
```
